## kernel/kernel-4.4/drivers/input/misc/compass/Kconfig
```kconfig
#
# Kconfig for stand-alone compass input device drivers
#

config ML_AK9912
	tristate "AKM 9912 devices"
	depends on SPI && SYSFS && INPUT
	default n
	help
      This driver supports the AKM 9912 devices.
      Driver uses SPI interface and reports data via
      input subsystem.
      Driver supports all four data rates (10, 20, 50, 100Hz)


config INV_AK8975
    tristate "Invensense AKM AK8975 compass input device driver"
    depends on I2C && SYSFS && INPUT && INPUT_EVDEV
    default n
    help
      This driver supports the AKM AK8975 compass device.
      This driver can be built as a module. The module will be called
      inv-ak8975.
```

## kernel/kernel-4.4/drivers/input/misc/imu/icm20602/Kconfig
```kconfig
#
# icm20602 drivers for Invensense IMU
#

config ML_ICM_20602
	tristate "Invensense ICM20602 devices"
	depends on SPI && SYSFS && INPUT
	default n
	help
		This driver supports the Invensense ICM20602 devices.
		Driver uses SPI interface and reports data via
		input subsystem.
		Driver supports data rate upto 1KHz
```

## kernel/kernel-4.4/drivers/media/platform/uvrc/Kconfig
```kconfig
comment "Magic Leap Remote Camera Support"

config ML_UVRC
	bool "Magic Leap USB Video Raw Camera module"
	depends on VIDEO_DEV && VIDEO_V4L2 && OF && ML_MUX
	select VIDEOBUF2_VMALLOC
	default n
	---help---
	  Enables the kernel driver that supports the remote camera as a USB
	  video raw camera device. The device will be exposed as a V4L2
	  compatible interface and route the necessary requests to the remote
	  wearable.

	  If unsure, say N.
```

## kernel/kernel-4.4/drivers/misc/ml-6dof/Kconfig
```kconfig
comment "Magic Leap Six Degree Of Freedom Driver"

config ML_6DOF
	bool "Magic Leap six degrees of freedom"
	depends on OF && I2C && SYSFS && TEGRA_AON
	help
	  This option enables support for Magic Leap
	  six degree of freedom sub-system. It includes
	  the main 6DOF controller driver and a number
	  of i2c clients.

source "drivers/misc/ml-6dof/raw/Kconfig"
```

## kernel/kernel-4.4/drivers/misc/ml-6dof/raw/Kconfig
```kconfig
comment "Magic Leap Six Degree Of Freedom Raw Mode Driver"

config ML_6DOF_RAW
	tristate "Magic Leap six degrees of freedom raw mode"
	depends on ML_6DOF
	help
	  This option enables support for Magic Leap
	  six degree of freedom sub-system operating
	  in raw data mode where all signal processing
	  of received electromagnetic data is done
	  in software components running in the user
	  space.
```

## kernel/kernel-4.4/drivers/misc/serdes-benchmark/Kconfig
```kconfig
config SERDES_BENCHMARK
	tristate "SERDES benchmark driver"
	default n
	---help---
	  This driver supports SERDES benchmarking.
```

## kernel/kernel-4.4/ml_sec/Kconfig
```kconfig
#
# MagicLeap's Security configuration
#

menu "MagicLeap's Security configuration"

config MLSEC_EXEC_IMPLIES_DENYWRITE
	bool "Deny changes to files that are mmap'd with execute permission"
	help
	   Sets the MAP_DENYWRITE when a file backed mmap is performed with
	   PROT_EXEC.

config MLSEC_ELF_SIGNING
	bool "Signature verification for all ELF binaries"
	depends on MLSEC_EXEC_IMPLIES_DENYWRITE
	depends on PAX_MPROTECT
	select SYSTEM_DATA_VERIFICATION
	select CRYPTO_SHA512
	help
	   Checks that each ELF binary that is loaded as executable is properly
	   signed during their load.

config MLSEC_ELF_SIGNING_DEVELOP
	bool "Enable Signing in development mode"
	depends on MLSEC_ELF_SIGNING
	help
	   In development mode, you can disable the signing using debugfs

config MLSEC_SANDBOX
	bool "Enable Sandbox features"
	help

config MLSEC_SANDBOX_AUDIT
	bool "Enable Sandbox auditing"
	depends on MLSEC_SANDBOX

config MLSEC_SANDBOX_DEVELOP
	bool "Enable Sandbox in development mode"
	depends on MLSEC_SANDBOX
	select MLSEC_SANDBOX_AUDIT
	help
	   Sandbox in development mode enables the use of 'syscalls.profile' and
	   'sandbox.profile' for manual control over the Sandbox operation.

config MLSEC_ALLOW_PERMISSIVE_DEBUGGING
	bool "Allow permissive debugging mode"
	depends on DEBUG_FS
	depends on PAX_MPROTECT
	help
	   Allow disabling all debug restrictions through debugfs

config MLSEC_COMMON
	bool "Common"
	default y if (MLSEC_SANDBOX || MLSEC_ELF_SIGNING)
	help
	   Do not set this directly, this turns on automatically if either of the
	   ML security features are set.

config MLSEC_CHECK_VERITY
	bool "Validate dm-verity enforcement"
	help
	   Verify that dm-verity is applied on ML internal partitions.

config MLSEC_HARDEN_PTRACE
	bool "Allow ptrace() only on debuggable executables"
	depends on MLSEC_ELF_SIGNING
	help
	   With this flag enabled, the ptrace() syscall will fail for any process
	   which is not marked "is_debuggable" through ML's taildata on the main
	   process executable.

config MLSEC_HARDEN_LOAD_SO
	bool "Allow loading a SO according to the executable's and its signatures"
	depends on MLSEC_ELF_SIGNING
	help
	   While loading a shared object:
	   1. ml-internal executable can't load non-ml-internal SO.
	   2. non-ml-internal SO can only get loaded to executable from same dir.

config MLSEC_SANDBOX_VIOLATION_LOGGING
	bool "Signal SIGVIOLATION if action is denied"
	depends on MLSEC_SANDBOX
	help
	   This option will cause the kernel to signal the calling process
	   if the action generates a sandbox violation.

config MLSEC_SELINUX_VIOLATION_LOGGING
	bool "Signal SIGVIOLATION if action is denied"
	depends on SECURITY_SELINUX
	help
	   This option will cause the kernel to signal the calling process
	   if the action generates SELinux violation.

config EXPECT_FACTORY_BUILD
	bool "Verify the bootloader and system of a factory build"

endmenu
```

## kernel/t18x/Documentation/devicetree/bindings/platform/tegra/aon-wearable.txt
```
Mlmux adapter/AON client driver

Implements a mlmux adapter to support mlmux client
to read/write wearable data over the AON mailbox.

Required properties:

- compatible	: must be "ml,aon-wearable"
- mboxes	: IVC channel

Example:

ml_mux2: aon_wearable {
	compatible = "ml,aon-wearable";
	mboxes = <&aon 5>;
	status = "okay";
};
```
