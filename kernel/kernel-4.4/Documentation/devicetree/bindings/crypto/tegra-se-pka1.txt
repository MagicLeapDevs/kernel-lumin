## kernel/kernel-4.4/Documentation/devicetree/bindings/pinctrl/nvidia,tegra21x-padctl-uphy.txt
```
Device tree binding for NVIDIA Tegra21x XUSB PADCTL/UPHY
========================================================

The Tegra21x XUSB PADCTL manages UTMI/HSIC/SuperSpeed USB 2.0/3.0 pads, each of
which can be configured with one out of HOST_ONLY/DEVICE_ONLY/OTG capabilities.
The Tegra21x UPHY manages internal UPHY lanes, each of which can be assigned to
one out of the function controllers: XUSB/PCIE/SATA/UFS.

This document defines the device-specific binding for the Tegra21x PADCTL/UPHY
driver. This driver models pads and lanes as phy instances with the generic phy
abstraction. Function drivers (XUSB/PCIE/SATA/UFS drivers) could retrieve its own
phy instance via devm_phy_get() call.

Refer to pinctrl-bindings.txt in this directory for generic information about
pin controller device tree bindings and ../phy/phy-bindings.txt for details on
how to describe and reference PHYs in device trees.

Required properties:
--------------------
- compatible: should be "nvidia,tegra21x-padctl-uphy"
- reg: Physical base address and length of PADCTL and UPHY.
- interrupts: IRQ number of PADCTL.
- #phy-cells: Should be 1. The specifier is the index of the PHY to reference.
  See <dt-bindings/pinctrl/pinctrl-tegra21x-padctl-uphy.h> for the list of valid values.
- mboxes: Must contain an entry for the XUSB mailbox channel.
  See ../mailbox/mailbox.txt for details.
- mbox-names: Must include the following entries:
  - xusb

Optional properties:
-------------------
- vbus-{0,1,2,3}-supply: VBUS regulator for the corresponding UTMI pad.
- vddio-hsic-supply: VDDIO regulator for the HSIC pads.

Lane muxing:
------------

Child nodes contain the pinmux configurations following the conventions from
the pinctrl-bindings.txt document. Typically a single, static configuration is
given and applied at boot time.

Each subnode describes groups of lanes along with parameters and pads that
they should be assigned to. The name of these subnodes is not important. All
subnodes should be parsed solely based on their content.

Each subnode only applies the parameters that are explicitly listed. In other
words, if a subnode that lists a function but no pin configuration parameters
implies no information about any pin configuration parameters. Similarly, a
subnode that describes only a parameter implies no information about what
function the pins are assigned to.

Required properties:
- nvidia,lanes: An array of strings. Each string is the name of a lane.

Optional properties:
- nvidia,function: A string that is the name of the function (pad) that the
  pin or group should be assigned to. Valid values for function names are
  listed below.
- nvidia,usb3-port: USB3 port (0/1/2/3) to which the lane is mapped.
- nvidia,usb2-map: USB2 port (0/1/2/3) to which the USB3 port is mapped.
- nvidia,port-cap: USB port capability.
- nvidia,pcie-controller: pcie controller number which the lane is assigned.
- nvidia,usb3-port-fake: Faked USB3 port (0/1/2/3) to which USB2 port is mapped.
  This property is required to support T210 device mode on "USB2.0 only" port.
  Driver configures only XUSB_PADCTL_SS_PORT_MAP_0 & XUSB_PADCTL_ELPG_PROGRAM_1
  for specified USB3 port without assign corresponding UPHY lane to USB3.
  This property is only valid for function "xusb".

Note that not all of these properties are valid for all lanes. Lanes can be
divided into four groups:

  - otg-0, otg-1, otg-2, otg-3:

    Valid functions for this group are: "xusb", "uart", "snps" , "rsvd".
    nvidia,port-cap property is required when the function is xusb.

  - hsic-0:

    Valid functions for this group are: "xusb", "rsvd".

  - uphy-lane-0, uphy-lane-1, uphy-lane-2, uphy-lane-3, uphy-lane-4,
    uphy-lane-5, uphy-lane-6, uphy-lane-7

    Valid functions for this group are: "pcie", "usb3", "sata", "rsvd".

    When function is usb3, nvidia,usb3-port and nvidia,port-cap are required.
    When function is pcie, nvidia,pcie-controller and nvidia,pcie-lane-select
    are required.

  - cdp-0, cdp-1, cdp-2, cdp-3:

    Valid functions for this group is: "xusb". No other property is required.
    This type of lane is an abstraction of Tegra CDP (charging downstream port)
    which can be turned on by host controller driver using generic phy API to
    declare a UTMI host port as CDP.

Example:
========

SoC file extract:
-----------------

	pinctrl@0x7009f000
		compatible = "nvidia,tegra21x-padctl-uphy";
		reg = <0x0 0x7009f000 0x0 0x1000>;
		interrupts = <0 49 0x4>;
		mboxes = <&xusb_mbox>;
		mbox-names = "xusb";

		#phy-cells = <1>;
	};

Board file extract:
-------------------

	# pcie-controller has C0 and C1 enabled.
	# "pcie-0" phy is assigned to C0; "pcie-1" phy is assigned to C1.
	pcie-controller@0,01003000 {
		...

		phys = <&board-padctl-uphy  TEGRA_PADCTL_UPHY_PCIE_P(0)>,
			<&board-padctl-uphy TEGRA_PADCTL_UPHY_PCIE_P(1)>;
		phy-names = "pcie-0", "pcie-1";

		...
	};

	...

	# XUSB host mode takes UTMI pad#2 and SuperSpeed pad#2 for a USB 3.0 host port.
	# Also add CDP support for that UTMI pad#2.
	xusb@0x70090000 {
		...
		phys = 	<&board-padctl-uphy TEGRA_PADCTL_UPHY_UTMI_P(2)>,
			<&board-padctl-uphy TEGRA_PADCTL_UPHY_USB3_P(2)>,
			<&board-padctl-uphy TEGRA_PADCTL_UPHY_CDP_P(2)>;
		phy-names = "utmi-2", "usb3-2", "cdp-2";

		...
	}

	...

	# XUSB device mode takes UTMI pad#0 and SuperSpeed pad#0 for a USB3.0 device port
	xudc@0x700d0000 {
		...
		phys = 	<&board-padctl-uphy TEGRA_PADCTL_UPHY_UTMI_P(0)>,
			<&board-padctl-uphy TEGRA_PADCTL_UPHY_USB3_P(0)>,
		phy-names = "usb2", "usb3";

		...
	}

	board-padctl-uphy: pinctrl@0x7009f000 {
		pinctrl-0 = <&pinctrl_default>;
		pinctrl-names = "default";

		vbus-2-supply = <&vdd_usb3_vbus>;

		pinctrl_default: pinmux {
			usb2-micro-AB {
				nvidia,lanes = "otg-0";
				nvidia,function = "xusb";
				nvidia,port-cap = <TEGRA_PADCTL_PORT_OTG_CAP>;
			};

			usb3-micro-AB {
				nvidia,lanes = "uphy-lane-0";
				nvidia,function = "usb3";
				nvidia,usb3-port = <0>;
				nvidia,usb2-map = <0>;
				nvidia,port-cap = <TEGRA_PADCTL_PORT_OTG_CAP>;
			};

			usb2-std-A {
				nvidia,lanes = "otg-2";
				nvidia,function = "xusb";
				nvidia,port-cap = <TEGRA_PADCTL_PORT_HOST_ONLY>;
			};

			usb3-std-A {
				nvidia,lanes = "uphy-lane-2";
				nvidia,function = "usb3";
				nvidia,usb3-port = <2>;
				nvidia,usb2-map = <2>;
				nvidia,port-cap = <TEGRA_PADCTL_PORT_HOST_ONLY>;
			};

			# pcie controller C0 takes uphy-lane-1 for x1 configuration
			pcie-c0 {
				nvidia,lanes = "uphy-lane-1";
				nvidia,function = "pcie";
				nvidia,pcie-controller = <0>;
				nvidia,pcie-lane-select =
						<TEGRA_PADCTL_PCIE_LANE_X1>;
			};

			# pcie controller C1 takes uphy-lane-3 for x1 configuration
			pcie-c1 {
				nvidia,lanes = "uphy-lane-3";
				nvidia,function = "pcie";
				nvidia,pcie-controller = <1>;
				nvidia,pcie-lane-select =
						<TEGRA_PADCTL_PCIE_LANE_X1>;
			};

			sata {
				nvidia,lanes = "uphy-lane-5";
				nvidia,function = "sata";
			};
		};
	};
```

## kernel/kernel-4.4/Documentation/devicetree/bindings/power_supply/mlmux-pmss.txt
```
ML Power Management SubSystem(PMSS) over MLMUX

Driver for ML proprietary PMSS communicating over MLMUX

Required properties:
 - compatible:		must be "ml,pmss_ml_mux".
 - ml,chan-name:	MLMUX client channel name.
 - mlmux:		phandle to the ML MUX controller.
 - extcon:		phandle to the extcon for controlling USB HOST stack state.

Optional properties:
 - vcomp_alert_irq: this property is used to create an interrupt which handles
				the case where VSYS drops below operating threshold.
 - #thermal-sensor-cells: 	when this property is set the thermal
 				frame work will be able to register the
 				node as a thermal sensor. It also enables
 				driver thermal fw sensor registration while
 				disabling power_supply thermal zone registration.
 - ml,batt_sens_id:
 - ml,chrg_sens_id: 	if we are using this node as thermal sensor then we can
 			optionally set these two variables to uniquely identify
 			battery id and charger id when registering with thermal
 			zone. If these options are not present and we are using
 			thermal sensor registration then batt id is 0 and chrg id
 			is 1.
 - ml,batt-hot-temp: 	if this property is set it will be used to signal
			to userspace that the battery is HOT and appropriate actions should be
			taken, e.g. start shutting down the system. The uevent will continuously
			be generated while in this state. If not set a DEFINE will be used instead.
			The unit is dC, i.e for 10.5C <105> should be used.
 - ml,batt-cold-temp: 	if this property is set it will be used to signal
			to userspace that the battery is COLD and appropriate actions should be
			taken, e.g. start shutting down the system. The uevent will continuously
			be generated while in this state. If not set a DEFINE will be used instead.
			The unit is dC, i.e for -10.5C <(-105)> should be used.
 - ml,batt-warm-temp: 	if this property is set it will be used to signal
			to userspace that the battery is WARM and appropriate actions should be
			taken, e.g. start shutting down the system. The uevent will continuously
			be generated while in this state. If not set only HOT state will be used.
			The unit is dC, i.e for 10.5C <105> should be used.
 - ml,batt-cool-temp: 	if this property is set it will be used to signal
			to userspace that the battery is COOL and appropriate actions should be
			taken, e.g. start shutting down the system. The uevent will be generated
			only on transition into this state. If not set only COLD state will be used.
			The unit is dC, i.e for -10.5C <(-105)> should be used.
 - bc12_cd:		phandle which points to device used for detecting BC1.2 ports. Used to get a
			reference to an extcon device that will notify us about BC1.2 port
			connection.
Example:
	ml_pmss {
		compatible = "ml,pmss_ml_mux";
		status = "okay";
		vcomp_alert_irq = <&tegra_aon_gpio TEGRA_AON_GPIO(S, 4) GPIO_ACTIVE_HIGH>;
		ml,chan-name = "pmss";
		mlmux = <&ml_mux1>;
		extcon = <&host_extcon>;
		bc12_cd = <&usb_cd>;
		ml,batt_sens_id = <0>;
		ml,chrg_sens_id = <1>;
		ml,batt-hot-temp = <600>;
		ml,batt-cool-temp = <(-10)>;
		ml,batt-cold-temp = <(-50)>;
	};
```

## kernel/kernel-4.4/Documentation/devicetree/bindings/thermal/nvidia,tegra-tj-thermal.txt
```
Tegra maximum (junction) temperature reporting (virtual) sensor

This module reports the maximum SoC temperature (hottest point on the chip). It
polls on the temperatures from existing sensor devices (thermal zones), adds a
'hotspot offset' to the respective temperatures just polled, and, reports back
the maximum of all those values.

The participating zones and their respective hotspot offsets are configurable
via device tree.

This virtual sensor works completely on the polling mechanism supported by the
thermal core, and, doesn't have any interrupts support.

Required properties:
- compatible: "nvidia,tegra-tj-thermal"
- data: Is an array/list of 'thermal-zone-phandle, hotspot offset(in mC)' pairs.
	There should exist at least one pair (two values) for a valid
	temperature reading.

Example:

/ {
	/* An example of bare bones thermal zone using tj-thermal virtual sensor
	 */
	tegra-tj {
		status = "okay";
		compatible = "nvidia,tegra-tj-thermal";
		#thermal-sensor-cells = <1>;
		data = <&CPU_zone 5000>;
	};

	thermal-zones {
		Tj-therm {
			polling-delay = <500>;
			polling-passive-delay = <500>;
			thermal-sensors = <&/tegra-tj 0>;
		};
	};
};


/ {
	/* An example of Tj attached with a cooling device
	 */
	tegra-tj {
		status = "okay";
		compatible = "nvidia,tegra-tj-thermal";
		#thermal-sensor-cells = <1>;
		data = <&CPU_zone 5000>;
	};

	tj-cdev {
		status = "okay";
		cooling-min-state = <0>;
		colling-max-state = <16>;
		#cooling-cells = <2>;
		cdev-type = "tj_test";
	};

	thermal-zones {
		Tj-therm {
			polling-delay = <500>;
			polling-passive-delay = <500>;
			thermal-sensors = <&/tegra-tj 0>;
		};
		trips {
			trip1 {
				.
				.
				.
			};
		};
		cooling-maps {
			map1 {
				trip = <&trip1>;
				cooling-device = <&tj-cdev 0 16>;
				cdev-type = "tj_test";
			};
		};
	};
};
```

## kernel/kernel-4.4/Documentation/devicetree/bindings/thermal/therm-mlmux.txt
```
ML Thermal Virtual Device over MLMUX

Virtual device communicating over MLMUX protocol.
The driver will register into Thermal FW and update the
temperature communicated over MLMUX.

Required properties:
 - compatible		: must be "ml,thern_mlmux"
 - ml,chan-name		: MLMUX client channel name
 - mlmux		: phandle to the ML MUX controller

Optional properties:
 - trip-ddr1-critical-temp  : Critical trip temperature for DDR1 thermistor to cause shutdown.
 - trip-ddr2-critical-temp  : Critical trip temperature for DDR2 thermistor to cause shutdown.
 - trip-ddr3-critical-temp  : Critical trip temperature for DDR3 thermistor to cause shutdown.
 - trip-fan-critical-temp   : Critical trip temperature for Fan thermistor to cause shutdown.
 - trip-ufs-critical-temp   : Critical trip temperature for UFS thermistor to cause shutdown.
 - trip-xxxx-critical-temp  : Critical trip temperature for any new xxxx thermistor to cause shutdown.
* Each of the trip points are Type: unsigned and Size: one cell.

Example:
	ml_therm {
		compatible = "ml,therm_mlmux";
		status = "okay";
		ml,chan-name = "therm";
		mlmux = <&ml_mux1>;
		trip-ufs-critical-temp = <80000>;
	};
```
