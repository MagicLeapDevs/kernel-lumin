## kernel/kernel-4.4/Documentation/devicetree/bindings/usb/nvidia,tegra186-xhci.txt
```
Device tree binding for NVIDIA Tegra XUSB host mode controller (XHCI)
============================

The Tegra xHCI controller complies to xHCI specifications which supports
both USB 2.0 HighSpeed/FullSpeed/LowSpeed and USB 3.0 SuperSpeed protocols.

Required properties:
--------------------
 - compatible: For Tegra186, must contain "nvidia,tegra186-xhci".
 - mboxes: Must contain an entry for the XUSB mailbox channel.
   See ../mailbox/mailbox.txt for details.
 - mbox-names: Must include the following entries:
   - xusb

Required properties for Tegra186:
---------------------------------
 - avddio_usb-supply: 3.3V supply to USB 2.0 pads.
 - avdd_pll_utmip-supply: 1.8V supply to UTMI PLL.
 - hvdd_usb-supply: 1.8V supply to PEX USB 3.0 pads.

 - phys: Must contain an entry for each entry in phy-names.
   See ../phy/phy-bindings.txt for details.
 - phy-names: Should include an entry for each PHY used by the controller.
   Names must be of the form "<type>-<number>" where <type> is one of "utmi",
   "hsic", "usb3", or "cdp" and <number> is a 0-based index.
   On Tegra186, there may be up to:
   - 3 USB3 PHYs, SuperSpeed (SSTX+/SSTX-/SSRX+/SSRX-) data lines
   - 3 UTMI PHYs, USB 2.0 (D+/D-) data lines
   - 1 HSIC PHYs, HSIC (DATA/STROBE) data lines
   - 3 CDP PHYs, which is an abstraction type of PHY to support CDP (charging
       downstream port) for each UTMI PHYs in the system

Optional properties:
--------------------
 - nvidia,pmc-usb-wakes-disabled: set if platform doesn't support/require waking system from
   suspend with USB events.
 - extcon-cables: OTG support. Must contains an excon-cable entry which detects
   USB ID pin. See ../extcon/extcon-gpio-states.txt for details.
   When the extcon cable state is 1, OTG port will transition to host mode.
 - extcon-cable-names: Must be "id".
 - nvidia,boost_cpu_freq: Set the value to which CPU frequency will be boosted.
   This is only the minimum frequency, DVFS can further scale up CPU frequency
   based on the need and cpu load. CPU boost freq through PMQOS will be enabled
   for xhci controller only when this field is a non-zero positive value. This
   boost is applicable only for Bulk and Isoc transfers, other endpoints doesn't
   need boost.
   Example :
   Before boosting on Quill-prod:
     Output of "cat /sys/devices/system/cpu/cpu*/cpufreq/scaling_cur_freq"
     345600
     2419200
     2419200
     345600
     345600
     345600
   After boosting on QUill-prod: (nvidia,boost_cpu_freq = <800>)
     Output of "cat /sys/devices/system/cpu/cpu*/cpufreq/scaling_cur_freq"
     806400
     2419200
     2419200
     806400
     806400
     806400
 - nvidia,boost_cpu_trigger: Minimum buffer length of the bulk or isoc transfers
   beyond which we boost frequency. This field is applicable only if
   "nvidia,boost_cpu_freq" > 0. This field should be > 16384(16KB), else driver
   will use default 16384.

Example:
--------
	xhci@3530000 {
		compatible = "nvidia,tegra186-xhci";
		mboxes = <&xusb_mbox>;
		mbox-names = "xusb";
		phys = <&padctl TEGRA_PADCTL_PHY_UTMI_P(0)>, /* USB 2.0 micro-AB, J20 */
			<&padctl TEGRA_PADCTL_PHY_UTMI_P(1)>, /* USB 3.0 STD-A, J19 */
			<&padctl TEGRA_PADCTL_PHY_USB3_P(1)>, /* USB 3.0 STD-A, J19 */
			<&padctl TEGRA_PADCTL_PHY_CDP_P(1)>; /* CDP for J19 port */
		phy-names = "utmi-0", "utmi-1", "usb3-1", "cdp-1";

		avddio_usb-supply = <&spmic_sd3_3v3>;
		avdd_pll_utmip-supply = <&spmic_sd2_1v8>;
		hvdd_usb-supply =  <&spmic_sd2_1v8>;

		extcon-cables = <&vbus_id_extcon 1>;
		extcon-cable-names = "id";
		#extcon-cells = <1>;

		nvidia,boost_cpu_freq = <800>;
		nvidia,boost_cpu_trigger = <18432>;
	};
```

## kernel/kernel-4.4/Documentation/devicetree/bindings/usb/nvidia,tegra186-xotg.txt
```
Device tree binding for NVIDIA Tegra XUSB OTG Controller Driver (XOTG)
============================

The Tegra XOTG driver works with Tegra host and device controller drivers to
provide OTG2.0 (OTG3.0 supported, but not implemented yet in SW)
functionalities. The host and device controller drivers must both contain
otg-controller phandle pointing to XOTG node. Host or device driver only
depends on XOTG driver. If a system has OTG port but either XHCI or XUDC
is not enabled, the port still works fine as long as XOTG is enabled. In
other words, either one or both XHCI and XUDC should work fine as long as
XOTG is enabled.

Required properties:
--------------------
 - compatible: For Tegra186, must contain "nvidia,tegra186-xotg".

Required properties for Tegra186:
---------------------------------
 - interrupts: interrupt line for XOTG
 - phys: Must contain at least an entry for USB2.0 phy for the OTG port, and
   at most an additional entry for USB3.0 phy if the OTG port is USB3.0.
   See ../phy/phy-bindings.txt for details.
 - phy-names: Should include at least an entry for USB2.0 phy and at most
   another entry for USB3.0 phy.
   Names must be "otg-usb2", and "otg-usb3" if the port supports SuperSpeed.
   - "otg-usb3" phy, SuperSpeed (SSTX+/SSTX-/SSRX+/SSRX-) data lines
   - "otg-usb2" phy, USB 2.0 (D+/D-) data lines
 - extcon-cables: Must contains 2 cables for ID and VBUS detection.
   See ../extcon/extcon-gpio-states.txt for details.
 - extcon-cable-names: Must be "id" and "vbus".

Optional properties:
--------------------
 - otg-rev: See generic.txt for details
 - hnp-disable: See generic.txt for details
 - adp-disable: See generic.txt for details
 - srp-disable: See generic.txt for details
 - rsp-disable: See generic.txt for details

Example:
--------
	xotg {
		compatible = "nvidia,tegra186-xotg";
        interrupts = <0 167 0x4>;
		phys = <&padctl TEGRA_PADCTL_UTMI_P(0)>, /* USB 3.0 micro-AB, J503 */
			<&padctl TEGRA_PADCTL_USB3_P(1)>; /* USB 3.0 micro-AB, J503 */
		phy-names = "otg-usb2", "otg-usb3";
		extcon-cables = <&vbus_id_extcon 1>, <&vbus_id_extcon 0>;
		extcon-cable-names = "id", "vbus";
		#extcon-cells = <1>;

        otg-rev = <0x0300>;
        adp-disable;
	};
```

## kernel/kernel-4.4/drivers/android/Kconfig
```kconfig
menu "Android"

config ANDROID
	bool "Android Drivers"
	---help---
	  Enable support for various drivers needed on the Android platform

if ANDROID

config ANDROID_BINDER_IPC
	bool "Android Binder IPC Driver"
	depends on MMU
	default n
	---help---
	  Binder is used in Android for both communication between processes,
	  and remote method invocation.

	  This means one Android process can call a method/routine in another
	  Android process, using Binder to identify, invoke and pass arguments
	  between said processes.

config ANDROID_BINDER_DEVICES
	string "Android Binder devices"
	depends on ANDROID_BINDER_IPC
	default "binder"
	---help---
	  Default value for the binder.devices parameter.

	  The binder.devices parameter is a comma-separated list of strings
	  that specifies the names of the binder device nodes that will be
	  created. Each binder device has its own context manager, and is
	  therefore logically separated from the other devices.

config ANDROID_BINDER_IPC_32BIT
	bool
	depends on !64BIT && ANDROID_BINDER_IPC
	default y
	---help---
	  The Binder API has been changed to support both 32 and 64bit
	  applications in a mixed environment.

	  Enable this to support an old 32-bit Android user-space (v4.4 and
	  earlier).

	  Note that enabling this will break newer Android user-space.

config ANDROID_BINDER_TRANSACTION_LOG
	bool "Android Binder Transaction Log"
	depends on DEBUG_FS && ANDROID_BINDER_IPC
	default n
	---help---
	  The binder transaction log is useful for debugging but only so
	  if DEBUGFS is enabled. If there are no debugfs files created to
	  even view the transaction log, we can skip recording each transaction
	  and save some small processing time.

endif # if ANDROID

endmenu
```
