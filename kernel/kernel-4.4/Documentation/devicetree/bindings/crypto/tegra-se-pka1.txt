## kernel/kernel-4.4/Documentation/devicetree/bindings/crypto/tegra-se-pka1.txt
```
TEGRA SE ELLIPTIC PKA1 Crypto Module

Required properties:

- compatible : Should contain entries for this and backward compatible
  - "nvidia,tegra-se-pka1" for SE-PKA1.
  - This supports PKA1 features that include RSA and ECC internally.
- reg : Offset and length of the register set for the module
- clock-names: clocks required for Tegra SE to function

Example:
	se: se_pka1@3ad0000 {
		compatible = "nvidia,tegra-se-pka1";
		reg = <0x0 0x03ad0000 0x0 0x10000>,
		      <0x0 0x03ae0000 0x0 0x10000>;
		clocks = <&tegra_car TEGRA214_CLK_SE>;
		clock-names = "se";
	};
```

## kernel/kernel-4.4/Documentation/devicetree/bindings/gpio/gpio-mlmux.txt
```
Magic Leap MUX GPIO controller

A remote GPIO controller to expose GPIOS on the wearable as normal kernel
GPIOS that can be configured via the typical gpio_ family of APIs. The
current implementation does not support interrupt notification and thus
creates solely a GPIO controller.

The main node shall describe the necessary information to setup the gpio
controller and all children nodes are describing GPIOs which shall be
exposed through the 'ml,gpio-name' property.

--- Root Node ---

Required properties:
- compatible : Should be "ml,gpio-mlmux"
- reg : Address and length of the register set for the device
- #gpio-cells : Should be two. The first cell is the pin number and the
  second cell is used to specify optional parameters (currently unused).
- gpio-controller : Marks the device node as a GPIO controller.
- #address-cells : Specify one address field. This must be 1.
- #size-cells : Specify no size-cells. This must be 0.
- ml,chan-name : The MLMUX channel name to communicate over the MLMUX
  protocol to the wearable.
- mlmux : The phandle of the ml_mux controller

--- Child Node ---

Required properties:
- ml,gpio-num : An arbitrary pin number corresponding closely to the
  gpio number on the remote. This is simply for referencing the specific
  gpio via the phandle.
- ml,gpio-name : The name of the GPIO on the remote wearable.
- ml,dir : The direction, 0 for input, 1 for output

Example:

wear_gpio: mlmux_gpio {
	#address-cells = <1>;
	#size-cells = <0>;

	#gpio-cells = <2>:
	gpio-controller;

	compatible = "ml,mlmux-gpio";
	ml,chan-name = "gpio";
	mlmux = <&ml_mux2>;

	gpio@0 {
		ml,gpio-num = <0>;
		ml,gpio-name = "BOOT0";
		ml,dir = /bits/ 8 <0>;
	};

	gpio@7 {
		ml,gpio-num = <7>;
		ml,gpio-name = "BOOT1";
		ml,dir = /bits/ 8 <1>;
	};
};
```

## kernel/kernel-4.4/Documentation/devicetree/bindings/i2c/i2c-ps8713.txt
```
Parade Technologies PS8713 I2C Redriver parameters

Required properties:
 - compatible: must be "parade,ps8713".
 - reg: I2C address.
 - chan-name: In child node, "ch-a" or "ch-b".

Optional properties in child nodes:
 - ch-disable: Disable channel.
 - rx-det-disable: Disable channel RX.Detect.
 - auto-pwr-saving-disable: Disable automatic power saving.
 - eq-level: Equalization level setting, values 0 - 6 for 4.5dB to 14.5dB.
 - signal-det: Signal detector threshold adjust, values 0 to 7.
 - idle-exit: Electrical idle exit time adjust, values 0 to 3.
 - idle-enter: Electrical idle enter time adjust, values 0 to 3.
 - input-term: Input termination adjust, values 0 for 48.5ohm or 7 for High Impedance.
 - power-saving: Power saving mode wake up signal detector threshold adjust, values 0 to 7.
 - tune-lfps-swing: Tune down LFPS swing, values 0 to 3.
 - de-emphasis: De-emphasis select, values 0 to 3.
 - output-ampl: Output amplitude select, values 0 to 7.
 - output-term: Output termination adjust, values 0 for 48.5ohm or 7 for High Impedance.
 - idle-time-switch: Idle time of the input signal to switch to power saving mode, values 0 to 3.

Example:

&i2c_6 {
	status = "okay";
	ps8713 {
		compatible = "parade,ps8713";
		reg = <0x29>;
		chan-a {
			rx-det-disable;
			auto-pwr-saving-disable;
			chan-name = "ch-a";
			eq-level = <6>;
			signal-det = <7>;
			idle-exit = <3>;
			idle-enter = <3>;
			input-term = <7>;
			power-saving = <7>;
			tune-lfps-swing = <3>;
			de-emphasis = <3>;
			output-ampl = <7>;
			output-term = <7>;
			idle-time-switch = <3>;
		};
		chan-b {
			chan-name = "ch-b";
			ch-disable;
		};
	};
};
```

## kernel/kernel-4.4/Documentation/devicetree/bindings/i2c/nordic,nrf52-i2c.txt
```
Nordic I2c client driver

Required Properties
-------------------
- compatible: Must contain "nordic,nrf52_ml_mux"
- queue-len: Sets number of frames for mux to use for tx queue
- max-write-len: Sets the maximum write length in bytes
- max-receive-len: Sets the maximum receive length in bytes
- interrupts: interrupt to signal drdy on nrf52.

Optional Property
-------------------
- tx-highpri: set the priority of mux tx queue to rt

Example:
&i2c_7 {
	status = "okay";
	ml_mux1: nrf52_ml_mux@66 {
		compatible = "nordic,nrf52_ml_mux";
		reg = <0x66>;
		queue-len = <20>;
		max-write-len = <128>;
		max-receive-len = <128>;
		wakeup-source;
		interrupt-parent = <&tegra_gpio>;
		interrupts = <TEGRA_GPIO(D, 3) GPIO_ACTIVE_HIGH>;
		interrupt-names = "irq";
		tx-highpri;
	};
};
```

## kernel/kernel-4.4/Documentation/devicetree/bindings/input/ak9912_spi.txt
```
Magic Leap ak9912 (beltpack compass) device driver

Required properties:
	- compatible: Should be "ml,ak9912" when using the Magic Leap icm20602 device
	- reg: SPI chip select numbert for the device
	- spi-max-frequency: Max SPI frequency to use
	- interrupt-parent: the phandle for the interrupt controller
	- interrupts: interrupt line

Example:
	spi-ak9912 {
		compatible = "ml,ak9912";
		reg = <0>; /* spi chip select 0 */
		spi-max-frequency = <3000000>;
		interrupt-parent = <&tegra_main_gpio>;
		interrupts = <TEGRA_MAIN_GPIO(A, 1) GPIO_ACTIVE_HIGH>;
		status = "okay";
	};
```

## kernel/kernel-4.4/Documentation/devicetree/bindings/input/at42qt1010.txt
```
* Atmel AT42QT1010 QTouch device tree bindings

Required Properties:
- compatible 		:	Shall contain "atmel,at42qt1010".
- pwr_supply		:	Power supply needed to power the touch device
- gpio_irq			:	GPIO for the interrupt signal.
- gpio_sync			:	GPIO for the SYNC pin.
- run_mode			:	configuration for the SYNC pin. Possible values are
						"fast", "low_power", and "sync".
- enable_on_suspend	:	Enable IRQ on suspend state.


Example:
	at42qt1010_touch_sensor {
		compatible = "atmel,at42qt1010";
		pwr_supply = <&at42qt1010_pwr>;
		gpio_irq = <&tegra_gpio TEGRA_GPIO(AA, 4) GPIO_ACTIVE_HIGH>;
		gpio_sync = <&tegra_gpio TEGRA_GPIO(Z, 2) GPIO_ACTIVE_HIGH>;
		run_mode = "fast";
		enable_on_suspend = <0>;
	};
```

## kernel/kernel-4.4/Documentation/devicetree/bindings/input/gpio-charger-mode.txt
```
Device-Tree bindings for input/gpio_charger_mode.c keyboard driver

Required properties:
	- compatible = "ml,gpio-charger-mode";
	- gpios: OF device-tree gpio specification
	- wakeup-source: Is this gpio a wake up source

Example nodes:

	gpio-charger-mode {
		status = "disabled";
		compatible = "ml,gpio-charger-mode";
		gpios = <&tegra_aon_gpio TEGRA_AON_GPIO(FF, 0) GPIO_ACTIVE_LOW>;
		wakeup-source;
	};
```

## kernel/kernel-4.4/Documentation/devicetree/bindings/input/icm20602_spi.txt
```
Magic Leap icm20602 (beltpack imu) device driver

Required properties:
	- compatible: Should be "ml,icm20602" when using the Magic Leap icm20602 device
	- reg: SPI chip select numbert for the device
	- spi-max-frequency: Max SPI frequency to use
	- interrupt-parent: the phandle for the interrupt controller
	- interrupts: interrupt line
	- rate: default output data rate for accel and gyro
	- acc_en: default state for accel driver
	- acc_fsr: full scale range for accel
	- acc_avg: avg filter settings for accel
	- acc_dlpf: low pass filter settings for accel
	- gyr_en: default state for gyro driver
	- gyr_fsr: full scale range for gyro
	- gyr_avg: avg setting for gyro
	- gyr_dlpf: low pass filter for gyro

Example:
	spi-icm20602 {
		compatible = "ml,icm20602";
		reg = <1>; /* spi chip select 1 */
		spi-max-frequency = <5000000>;
		interrupt-parent = <&tegra_main_gpio>;
		interrupts = <TEGRA_MAIN_GPIO(X, 6) GPIO_ACTIVE_HIGH>;
		rate = <10>; /* Hz */
		acc_en = <0>;
		acc_fsr = <8>; /* +-g */
		acc_avg = <4>; /* samples */
		acc_dlpf = <3>;
		gyr_en = <0>;
		gyr_fsr = <500>; /* +-dps */
		gyr_avg = <1>; /* samples */
		gyr_dlpf = <3>;
		status = "okay";
	};
```

## kernel/kernel-4.4/Documentation/devicetree/bindings/input/mltotem.txt
```
Magic Leap Totem device driver

Required properties:
	- compatible: Should be "ml,totem" when using the Magic Leap Totem device
	- reg: SPI chip select numbert for the device
	- spi-max-frequency: Max SPI frequency to use
	- interrupt-parent: the phandle for the interrupt controller
	- interrupts: interrupt line

Example:
	spi-totem {
		compatible = "ml,totem";
		reg = <0>; /* spi chip select 0 */
		spi-max-frequency = <8000000>;
		interrupt-parent = <&tegra_aon_gpio>;
		interrupts = <TEGRA_AON_GPIO(AA, 2) GPIO_ACTIVE_LOW>;
		status = "okay";
	};
```

## kernel/kernel-4.4/Documentation/devicetree/bindings/misc/ml-6dof/6dof.txt
```
Magic Leap six degrees of freedom driver

Implements a 6DOF controller driver that communicates with
SPE over mailbox and with bus client drivers controlling
different peripherals of 6DOF sub-system.

Required properties:

- compatible	: must be "ml,aon-6dof"
- mboxes	: IVC channel

Example:

aon_6dof {
	compatible = "ml,aon-6dof";
	mboxes = <&aon 5>;
};
```

## kernel/kernel-4.4/Documentation/devicetree/bindings/misc/ml-6dof/adc.txt
```
Magic Leap Analog To Digital (ADC) on the wearable side

Required properties:

  - compatible: must be "ml,adc-i2c"
  - reg: the I2c address of ADC

Example:

ml_wear_adc {
	compatible = "ml,adc-i2c";
	reg = <0x31>;
};
```

## kernel/kernel-4.4/Documentation/devicetree/bindings/misc/ml-6dof/aon-em-raw.txt
```
Magic Leap Raw Electromagnetic Data Driver

Implements a 6DOF controller driver that communicates with
SPE over mailbox and pipes raw electromagnetic data from
SPE to userspace components.

Required properties:

- compatible	: must be "ml,aon-em-raw"
- mboxes	: IVC channel

Example:

aon_em_raw {
	compatible = "ml,aon-em-raw";
	mboxes = <&aon 2>;
};
```

## kernel/kernel-4.4/Documentation/devicetree/bindings/misc/ml-6dof/bp-fpga.txt
```
Magic Leap FPGA on the beltpack side

Required properties:

  - compatible: must be "ml,bp-fpga-i2c"
  - reg: the I2c address of FPGA

Example:

bp_fpga@52 {
	compatible = "ml,bp-fpga-i2c";
	reg = <0x52>;
};
```

## kernel/kernel-4.4/Documentation/devicetree/bindings/misc/ml-i2cmux.txt
```
ML Virtual I2C Adapter over MLMUX

Implements a virtual i2c adapter than will tunnel i2c read and write register
configurations over the MLMUX protocol.

Required properties:
 - compatible		: must be "ml,i2c-mux"
 - #address-cells	: must be <1>
 - #size-cells		: must be <0>
 - ml,chan-name		: name of the channel in the MLMUX path
 - mlmux		: phandle to the ML MUX controller

Example:
	i2c_mlmux0 {
		compatible = "ml,i2c-mlmux";
		status = "okay";

		ml,chan-name = "i2c0";
		mlmux = <&ml_mux2>;
	};
```

## kernel/kernel-4.4/Documentation/devicetree/bindings/misc/ml-serdes-benchmark.txt
```
ML serdes-benchmark parameters

Required properties:
 - compatible		: Must contain "ml,serdes-benchmark" for the magic leap wearable device
 - ml,chan-name     : Name of channel that will be used for SERDES benchmarking tests.

Example:
	wear_benchmark: benchmark0 {
		#address-cells = <1>;
		#size-cells = <0>;

		compatible = "ml,serdes-benchmark";
		ml,chan-name = "benchmark";
		mlmux = <&ml_mux2>;
	};
```

## kernel/kernel-4.4/Documentation/devicetree/bindings/misc/ml-wearable.txt
```
ML wearable parameters

Required properties:
 - compatible		: Must contain "ml,wearable" for the magic leap wearable device
 - pwr-supply		: Power supply needed to power wearable.
 - gpio_irq		: GPIO for interrupt to power pack.
 - gpio_on_off		: GPIO for on-off signal to wearable.
 - gpio_ap_int		: GPIO for interrupt to wearable.
 - gpio_vsync_en	: GPIO to route VSYNC signal over headset jack when low.

Example:
	wearable {
		compatible = "ml,wearable";
		status = "okay";
		pwr-supply = <&wearable_boost_4p8>;
		gpio_irq = <&tegra_gpio TEGRA_GPIO(J, 7) GPIO_ACTIVE_HIGH>;
		gpio_on_off = <&tegra_gpio TEGRA_GPIO(Y, 0) GPIO_ACTIVE_HIGH>;
		gpio_ap_int = <&tegra_gpio TEGRA_GPIO(P, 3) GPIO_ACTIVE_HIGH>;
		gpio_vsync_en = <&tegra_gpio TEGRA_GPIO(D, 2) GPIO_ACTIVE_LOW>;
	};
```

## kernel/kernel-4.4/Documentation/devicetree/bindings/mlgz_ctrl.txt
```
Magic Leap Gazell control driver

Required properties:
 - compatible          : Must contain "ml,mlgz_ctrl" for the magic leap Gazell driver

Example:
       gazell {
               compatible = "ml,mlgz_ctrl";
               status = "okay";
       };
```
