/*
 * tegra186-phaedra-p3b.dts
 *
 * Main device tree for the phaedra product.
 *
 * Copyright (c) 2017, Magic Leap, Inc.  All rights reserved.
 *
 * This program is free software; you can redistribute it and/or modify
 * it under the terms of the GNU General Public License as published by
 * the Free Software Foundation; version 2 of the License.
 *
 * This program is distributed in the hope that it will be useful, but WITHOUT
 * ANY WARRANTY; without even the implied warranty of MERCHANTABILITY or
 * FITNESS FOR A PARTICULAR PURPOSE.  See the GNU General Public License for
 * more details.
 */

#include "tegra186-phaedra.dtsi"
#include "tegra186-platforms/tegra186-phaedra-platform-p3b.dtsi"

/ {
	nvidia,dtsfilename = __FILE__;
};
