/*
 * tegra186-phaedra-platform-p5a.dtsi
 *
 * Main device tree for the phaedra product.
 *
 * Copyright (c) 2017, Magic Leap, Inc.  All rights reserved.
 *
 * This program is free software; you can redistribute it and/or modify
 * it under the terms of the GNU General Public License as published by
 * the Free Software Foundation; version 2 of the License.
 *
 * This program is distributed in the hope that it will be useful, but WITHOUT
 * ANY WARRANTY; without even the implied warranty of MERCHANTABILITY or
 * FITNESS FOR A PARTICULAR PURPOSE.  See the GNU General Public License for
 * more details.
 */

#include "tegra186-platforms/tegra186-phaedra-power.dtsi"

/ {
	thermal-zones {
		/delete-node/ tmp108_batt;
		/delete-node/ tmp108_wlan;
	};
};

&tmp108_batt_sensor {
	status = "disabled";
};

&tmp108_wlan_sensor {
	status = "disabled";
};
