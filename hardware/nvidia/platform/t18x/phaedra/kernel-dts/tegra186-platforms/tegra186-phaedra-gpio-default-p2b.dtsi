/*
 * Copyright (c) 2015, NVIDIA CORPORATION.  All rights reserved.
 *
 * This program is free software; you can redistribute it and/or modify
 * it under the terms of the GNU General Public License as published by
 * the Free Software Foundation; either version 2 of the License, or
 * (at your option) any later version.
 *
 * This program is distributed in the hope that it will be useful, but WITHOUT
 * ANY WARRANTY; without even the implied warranty of MERCHANTABILITY or
 * FITNESS FOR A PARTICULAR PURPOSE.  See the GNU General Public License for
 * more details.
 */

#include <dt-bindings/gpio/tegra-gpio.h>

/ {
	gpio@2200000 {
		gpio-init-names = "default";
		gpio-init-0 = <&gpio_default>;

		gpio_default: default {
			gpio-input = <
				TEGRA_GPIO(B, 1)
				TEGRA_GPIO(B, 5)
				TEGRA_GPIO(C, 0)
				TEGRA_GPIO(J, 5)
				TEGRA_GPIO(K, 0)
				TEGRA_GPIO(M, 5)
				TEGRA_GPIO(O, 0)
				TEGRA_GPIO(O, 1)
				TEGRA_GPIO(N, 2)
				TEGRA_GPIO(FF, 1)
				TEGRA_GPIO(FF, 2)
				TEGRA_GPIO(FF, 3)
				TEGRA_GPIO(FF, 4)
				TEGRA_GPIO(U, 3)
				TEGRA_GPIO(U, 5)
				TEGRA_GPIO(FF, 0)
				TEGRA_GPIO(S, 2)
				TEGRA_GPIO(X, 7)
				TEGRA_GPIO(Y, 0)
				TEGRA_GPIO(Y, 1)
				TEGRA_GPIO(Y, 2)
				TEGRA_GPIO(Y, 5)
				TEGRA_GPIO(L, 4)
				TEGRA_GPIO(H, 1)
				TEGRA_GPIO(V, 0)
				TEGRA_GPIO(V, 5)
				TEGRA_GPIO(Z, 1)
				TEGRA_GPIO(Z, 2)
				TEGRA_GPIO(Z, 3)
				TEGRA_GPIO(AA, 2)
				TEGRA_GPIO(AA, 5)
				TEGRA_GPIO(AA, 6)
				TEGRA_GPIO(P, 2)
				TEGRA_GPIO(P, 5)
				>;
			gpio-output-low = <
				TEGRA_GPIO(B, 4)
				TEGRA_GPIO(J, 6)
				TEGRA_GPIO(J, 7)
				TEGRA_GPIO(M, 1)
				TEGRA_GPIO(M, 0)
				TEGRA_GPIO(N, 0)
				TEGRA_GPIO(N, 1)
				TEGRA_GPIO(U, 0)
				TEGRA_GPIO(U, 4)
				TEGRA_GPIO(S, 3)
				TEGRA_GPIO(Y, 4)
				TEGRA_GPIO(H, 6)
				TEGRA_GPIO(H, 2)
				TEGRA_GPIO(W, 4)
				TEGRA_GPIO(P, 6)
				>;
			gpio-output-high = <
				TEGRA_GPIO(B, 6)
				TEGRA_GPIO(A, 2)
				TEGRA_GPIO(U, 1)
				TEGRA_GPIO(X, 6)
				TEGRA_GPIO(Y, 3)
				TEGRA_GPIO(Y, 6)
				TEGRA_GPIO(L, 5)
				TEGRA_GPIO(H, 4)
				TEGRA_GPIO(H, 3)
				TEGRA_GPIO(V, 4)
				TEGRA_GPIO(Z, 0)
				TEGRA_GPIO(AA, 3)
				TEGRA_GPIO(AA, 4)
				TEGRA_GPIO(P, 3)
				TEGRA_GPIO(P, 4)
				>;
		};
	};
};
